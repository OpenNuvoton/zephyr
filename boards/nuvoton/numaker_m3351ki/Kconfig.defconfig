## boards/nuvoton/numaker_m3351ki/numaker_m3351ki_m335xxx_ns_defconfig
```kconfig
# SPDX-License-Identifier: Apache-2.0

# TrustZone
CONFIG_TRUSTED_EXECUTION_NONSECURE=y

CONFIG_GPIO=y

# Enable system clock controller driver
CONFIG_CLOCK_CONTROL=y
CONFIG_CLOCK_CONTROL_NUMAKER_SCC=y

# Enable UART driver
CONFIG_SERIAL=y
CONFIG_UART_INTERRUPT_DRIVEN=y

# Console
CONFIG_CONSOLE=y
CONFIG_UART_CONSOLE=y
```

## samples/subsys/mgmt/mcumgr/smp_svr/boards/numaker_m3351ki_m335xxx_ns_no_tfm.conf
```kconfig
# SPDX-FileCopyrightText: Copyright (c) 2026 Nuvoton Technology Corporation
# SPDX-License-Identifier: Apache-2.0

CONFIG_BUILD_WITH_TFM=n
```
